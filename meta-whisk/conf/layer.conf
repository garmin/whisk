## meta-whisk/conf/layer.conf
```bitbake
# We have a conf directory, add to BBPATH
BBPATH .= ":${LAYERDIR}"

# We have recipes, add them to BBFILES
BBFILES += "\
    ${LAYERDIR}/recipes-*/*/*.bb \
    ${LAYERDIR}/recipes-*/*/*.bbappend \
    "

BBFILE_COLLECTIONS += "whisk"
BBFILE_PATTERN_whisk = "^${LAYERDIR}/"
BBFILE_PRIORITY_whisk = "6"

LAYERSERIES_COMPAT_whisk = "zeus dunfell gatesgarth"
```
